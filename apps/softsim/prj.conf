## CMakeLists.txt
```
# SPDX-FileCopyrightText: Copyright (c) 2023-2024 Onomondo ApS
# SPDX-License-Identifier: GPL-3.0-only

cmake_minimum_required(VERSION 3.20.0)

# Upstream hardcodes $ENV{ZEPHYR_BASE}/../modules/lib/onomondo-softsim, which assumes
# the module was pulled in by west into the NCS workspace. We keep it out-of-tree under
# this project instead, so point at it directly.
set(SOFTSIM_MODULE_DIR "${CMAKE_CURRENT_SOURCE_DIR}/../../modules/onomondo-softsim" CACHE PATH "onomondo-softsim module root")
if(NOT EXISTS "${SOFTSIM_MODULE_DIR}/overlay-softsim.conf")
  message(FATAL_ERROR "onomondo-softsim not found at ${SOFTSIM_MODULE_DIR}. Clone it with:\n"
                      "  git clone https://github.com/onomondo/nrf-softsim.git modules/onomondo-softsim\n"
                      "  git -C modules/onomondo-softsim submodule update --init")
endif()
list(APPEND OVERLAY_CONFIG "${SOFTSIM_MODULE_DIR}/overlay-softsim.conf")

# Must come after the module overlay: it re-sizes the TF-M partition that
# overlay-softsim.conf pins to 0x18000, to keep the non-secure start address
# 32 KB aligned once MCUboot's pad is in the layout. See the file for the sums.
list(APPEND OVERLAY_CONFIG "${CMAKE_CURRENT_SOURCE_DIR}/overlay-mcuboot.conf")

find_package(Zephyr REQUIRED HINTS $ENV{ZEPHYR_BASE})
project(softsim)

target_sources(app PRIVATE src/main.c src/profile_serial.c)
```

## sysbuild.conf
```
# Partition Manager is deprecated and no longer enabled by default from NCS 3.4.
# SoftSIM still relies on it (pm_static.yml layouts, NVS storage placement, and
# the bundled template.hex address in ../../sysbuild/CMakeLists.txt), so opt in.
SB_CONFIG_PARTITION_MANAGER=y

SB_CONFIG_SOFTSIM_BUNDLE_TEMPLATE_HEX=y

# MCUboot is not in the upstream sample, but the Feather has no onboard debugger.
# Building it in means the single SWD flash of merged.hex (which is the only way to
# place template.hex at the nvs_storage address) also installs a bootloader, so every
# later app update goes over serial DFU with flash.ps1 instead of needing the J-Link.
SB_CONFIG_BOOTLOADER_MCUBOOT=y
```

## prj.conf
```kconfig
# --- SoftSIM profile source -------------------------------------------------
# Default: EXTERNAL - the device waits for a profile over serial on first boot,
# provisions it, then reboots.
#
# For STATIC mode, uncomment the two lines below and replace the profile string with
# your Onomondo SoftSIM profile (hex string, as printed by `./softsim next` of the SoftSIM CLI Tool).
# CONFIG_SOFTSIM_STATIC_PROFILE_ENABLE=y
# CONFIG_SOFTSIM_STATIC_PROFILE="01120809101010325476980214980010325476981032140320000000000000000000000000000000000420000102030405060708090A0B0C0D0E0F0520000102030405060708090A0B0C0D0E0F0620000102030405060708090A0B0C0D0E0F"

# Configured to allow a reboot following the provisioning of a profile
CONFIG_REBOOT=y

# SoftSIM debug logging
CONFIG_SOFTSIM_NRF_DEBUG_LOGS=n
CONFIG_SOFTSIM_LIBS_DEBUG_LOGS=n

# Lossless library trace (debug only, buadrate 1000000); see SOFTSIM_LOG_IMMEDIATE_MODE Kconfig help.
# CONFIG_LOG_MODE_IMMEDIATE=y

# Factory reset the modem - helpful for development when the modem may be in an unknown state.
CONFIG_SOFTSIM_FACTORY_RESET_ON_PROVISION=n

# Modem Configurations
CONFIG_NRF_MODEM_LIB=y

# nRF modem library logging, linking the log-capable modem-library when enabled.
# CONFIG_NRF_MODEM_LOG=y
# CONFIG_NRF_MODEM_LIB_LOG_LEVEL_DBG=y

# NET Configurations
CONFIG_NETWORKING=y
CONFIG_NET_SOCKETS=y
CONFIG_NET_NATIVE=n
CONFIG_NET_SOCKETS_OFFLOAD=y
CONFIG_POSIX_API=y

# LTE Configurations
CONFIG_LTE_LINK_CONTROL=y
CONFIG_LTE_LC_PSM_MODULE=y
CONFIG_LTE_LC_EDRX_MODULE=y

# AT host library
CONFIG_SERIAL=y
CONFIG_AT_HOST_LIBRARY=y
CONFIG_UART_INTERRUPT_DRIVEN=y

# Reduce the size of TF-M by disabling the PS
CONFIG_TFM_PARTITION_PROTECTED_STORAGE=n
CONFIG_PSA_CRYPTO_DRIVER_CC3XX=n

# CONFIG_PM_PARTITION_SIZE_TFM is deliberately NOT set here. The module's
# overlay-softsim.conf is appended to OVERLAY_CONFIG after prj.conf and pins it
# to 0x18000, so anything set here is silently overridden. The real value lives
# in overlay-mcuboot.conf, which CMakeLists.txt appends last.
#
# MCUboot itself is selected via SB_CONFIG_BOOTLOADER_MCUBOOT in sysbuild.conf.
# The upstream CONFIG_BOOTLOADER_MCUBOOT form is NCS 2.x and ignored under sysbuild.


# Status indication on the board LED(s). Both boards already get CONFIG_GPIO=y from
# their board defconfig, but src/status_led.c depends on it directly now, so say so.
CONFIG_GPIO=y
```

## src/main.c
```c
/*
 * SPDX-FileCopyrightText: Copyright (c) 2023-2026 Onomondo ApS
 * SPDX-License-Identifier: GPL-3.0-only
 */

#include <stdio.h>
#include <string.h>
#include <unistd.h>
#include <sys/socket.h>
#include <arpa/inet.h>
#include <netdb.h>

#include <nrf_softsim.h>
#include <modem/lte_lc.h>
#include <modem/nrf_modem_lib.h>
#include <nrf_modem_at.h>
#include <zephyr/kernel.h>
#include <zephyr/net/socket.h>
#include <zephyr/device.h>
#include <zephyr/drivers/uart.h>
#include <zephyr/logging/log.h>
#include <zephyr/logging/log_ctrl.h>
#include <zephyr/sys/reboot.h>

#include "profile_serial.h"
#include "status_led.h"

LOG_MODULE_REGISTER(softsim_sample, LOG_LEVEL_INF);

/* Headroom over the full SoftSIM profile (~410 chars incl. SMSP/PIN/SMSC) */
#define PROFILE_MAX_SIZE 512

K_SEM_DEFINE(lte_connected, 0, 1); /* Semaphore to signal LTE connection established */

static const struct device *const uart_dev = DEVICE_DT_GET(DT_NODELABEL(uart0));

static void lte_handler(const struct lte_lc_evt *const evt)
{
	switch (evt->type) {
	case LTE_LC_EVT_NW_REG_STATUS:
		if ((evt->nw_reg_status != LTE_LC_NW_REG_REGISTERED_HOME) &&
		    (evt->nw_reg_status != LTE_LC_NW_REG_REGISTERED_ROAMING)) {
			/* Not registered. Distinguish "still looking" from "the network
			 * said no", since the second one will not fix itself.
			 */
			switch (evt->nw_reg_status) {
			case LTE_LC_NW_REG_REGISTRATION_DENIED:
			case LTE_LC_NW_REG_UICC_FAIL:
				status_led_set(STATUS_LED_ERROR);
				break;
			default:
				status_led_set(STATUS_LED_LTE_SEARCHING);
				break;
			}
			break;
		}

		LOG_INF("Network registration status: %s",
			evt->nw_reg_status == LTE_LC_NW_REG_REGISTERED_HOME
				? "Connected - home network"
				: "Connected - roaming");
		status_led_set(STATUS_LED_LTE_CONNECTED);
		k_sem_give(&lte_connected);
		break;
	case LTE_LC_EVT_PSM_UPDATE:
		LOG_INF("PSM parameter update: TAU: %d, Active time: %d", evt->psm_cfg.tau,
			evt->psm_cfg.active_time);
		break;
	case LTE_LC_EVT_EDRX_UPDATE: {
		char log_buf[60];
		ssize_t len;

		len = snprintf(log_buf, sizeof(log_buf), "eDRX parameter update: eDRX: %f, PTW: %f",
			       (double)evt->edrx_cfg.edrx, (double)evt->edrx_cfg.ptw);
		if (len > 0) {
			LOG_INF("%s", log_buf);
		}
		break;
	}
	case LTE_LC_EVT_RRC_UPDATE:
		LOG_INF("RRC mode: %s",
			evt->rrc_mode == LTE_LC_RRC_MODE_CONNECTED ? "Connected" : "Idle");
		break;
	case LTE_LC_EVT_CELL_UPDATE:
		LOG_INF("LTE cell changed: Cell ID: %d, Tracking area: %d", evt->cell.id,
			evt->cell.tac);
		break;
	default:
		break;
	}
}

static void modem_connect(void)
{
	int err = lte_lc_connect_async(lte_handler);
	if (err) {
		LOG_ERR("Connecting to LTE network failed, error: %d", err);
		status_led_set(STATUS_LED_ERROR);
		return;
	}
	status_led_set(STATUS_LED_LTE_SEARCHING);
}

/* Reachability check against Google over the SoftSIM data path.
 *
 * The nRF9160's sockets are offloaded to the modem, which exposes no raw ICMP
 * socket, so there is no literal ping. A DNS resolve plus a TCP round-trip is
 * the equivalent proof: it exercises PDN activation, the modem's DNS, and an
 * end-to-end TCP session to Google. One pass moves well under 1 KB, which
 * matters on a PAYG SIM.
 */
static int ping_google(void)
{
	static const char req[] = "HEAD / HTTP/1.1\r\n"
				  "Host: google.com\r\n"
				  "Connection: close\r\n\r\n";
	struct addrinfo *res = NULL;
	struct addrinfo hints = {
		.ai_family = AF_INET,
		.ai_socktype = SOCK_STREAM,
	};
	char addr_str[INET_ADDRSTRLEN];
	char reply[128];
	int64_t t0;
	int fd = -1;
	int err;

	t0 = k_uptime_get();
	err = getaddrinfo("google.com", "80", &hints, &res);
	if (err || res == NULL) {
		LOG_ERR("DNS resolve of google.com failed: %d", err);
		return -1;
	}

	inet_ntop(AF_INET, &((struct sockaddr_in *)res->ai_addr)->sin_addr, addr_str,
		  sizeof(addr_str));
	LOG_INF("DNS: google.com -> %s (%lld ms)", addr_str, k_uptime_get() - t0);

	fd = socket(AF_INET, SOCK_STREAM, IPPROTO_TCP);
	if (fd < 0) {
		LOG_ERR("Failed to create TCP socket: %d", errno);
		err = -1;
		goto out;
	}

	t0 = k_uptime_get();
	if (connect(fd, res->ai_addr, res->ai_addrlen) < 0) {
		LOG_ERR("TCP connect to %s:80 failed: %d", addr_str, errno);
		err = -1;
		goto out;
	}
	LOG_INF("TCP connect to %s:80 OK (%lld ms)", addr_str, k_uptime_get() - t0);

	t0 = k_uptime_get();
	if (send(fd, req, sizeof(req) - 1, 0) < 0) {
		LOG_ERR("Failed to send HTTP request: %d", errno);
		err = -1;
		goto out;
	}

	ssize_t len = recv(fd, reply, sizeof(reply) - 1, 0);
	if (len <= 0) {
		LOG_ERR("No HTTP reply: %d", errno);
		err = -1;
		goto out;
	}

	reply[len] = '\0';
	char *eol = strpbrk(reply, "\r\n");
	if (eol) {
		*eol = '\0';
	}
	LOG_INF("HTTP reply: \"%s\" (round trip %lld ms)", reply, k_uptime_get() - t0);
	err = 0;

out:
	if (fd >= 0) {
		(void)close(fd);
	}
	freeaddrinfo(res);
	return err;
}

static void drain_logs_and_reboot(void)
{
	/* Flush the deferred log buffer over UART before the reboot discards it. */
	while (log_data_pending()) {
		log_process();
		k_yield();
	}
	sys_reboot(0);
}

static int provision_softsim_from_serial(void)
{
	if (!device_is_ready(uart_dev)) {
		LOG_ERR("UART device not found!");
		return -1;
	}

	char *profile = k_malloc(PROFILE_MAX_SIZE);
	__ASSERT_NO_MSG(profile != NULL);

	struct rx_buf_t rx = {
		.buf = profile,
		.len = PROFILE_MAX_SIZE,
		.pos = 0,
	};

	uart_irq_callback_user_data_set(uart_dev, serial_cb, &rx);
	uart_irq_rx_enable(uart_dev);

	status_led_set(STATUS_LED_AWAIT_PROFILE);

	do {
		LOG_INF("Transfer SoftSIM profile using serial COM port, terminate by "
			"newline character (return key)");
	} while (k_sem_take(&profile_received, K_SECONDS(20)));

	LOG_INF("Profile received: %zu characters in total", rx.pos);

	uart_irq_rx_disable(uart_dev);

	/* Provision the profile to the SoftSIM filesystem */
	if (nrf_softsim_provision((uint8_t *)profile, rx.pos) != 0) {
		LOG_ERR("SoftSIM Profile provisioning failed");
		status_led_set(STATUS_LED_ERROR);
	}

	k_free(profile);

#ifndef CONFIG_SOFTSIM_FACTORY_RESET_ON_PROVISION
	/* Reboot to free the UART for the AT host/monitor and bring the modem up
	 * cleanly with the new SIM. With factory reset enabled we must NOT reboot
	 * here: the modem is still uninitialised (AT commands return -NRF_EPERM, i.e.
	 * -1), so the reset waits until main() has called nrf_modem_lib_init() — see
	 * nrf_softsim_just_provisioned(). */
	drain_logs_and_reboot();
#endif /* !CONFIG_SOFTSIM_FACTORY_RESET_ON_PROVISION */

	return 0;
}

int main(void)
{
	LOG_INF("SoftSIM sample started.");

#ifndef CONFIG_SOFTSIM_AUTO_INIT
	/* Without auto-init the module's SYS_INIT is compiled out, so bring SoftSIM
	 * up here -- before nrf_softsim_check_provisioned(), which needs the
	 * filesystem this initializes. */
	if (nrf_softsim_init()) {
		LOG_ERR("Failed to initialize SoftSIM.");
		status_led_set(STATUS_LED_ERROR);
		return -1;
	}
#endif

	if (!nrf_softsim_check_provisioned()) {
		if (provision_softsim_from_serial() != 0) {
			return -1;
		}
	}

	status_led_set(STATUS_LED_MODEM_INIT);

	int32_t err = nrf_modem_lib_init();
	if (err) {
		LOG_ERR("Failed to initialize modem library, error: %d", err);
		status_led_set(STATUS_LED_ERROR);
	}

#ifndef CONFIG_SOFTSIM_AUTO_INIT
	/* The module's NRF_MODEM_LIB_ON_INIT hook is compiled out too, so select the
	 * software SIM here. Runtime SIM selection lives at this point: send this
	 * only when a profile is provisioned, and the device falls back to a
	 * physical SIM otherwise. */
	if (nrf_modem_at_printf("AT%%CSUS=2")) {
		LOG_ERR("Failed to select software SIM.");
	}
#endif

#ifdef CONFIG_SOFTSIM_FACTORY_RESET_ON_PROVISION
	/* Modem is now initialised; if a profile was just provisioned (static or
	 * serial), wipe modem NVM and reboot so it comes up clean with the new SIM. */
	if (!err && nrf_softsim_just_provisioned()) {
		nrf_softsim_modem_factory_reset();
		drain_logs_and_reboot();
	}
#endif /* CONFIG_SOFTSIM_FACTORY_RESET_ON_PROVISION */

	modem_connect();

	LOG_INF("Waiting for LTE connect event.");
	do {
	} while (k_sem_take(&lte_connected, K_SECONDS(10)));

	LOG_INF("LTE connected!");

	int failures = 0;

	for (int i = 1; i <= 3; i++) {
		LOG_INF("--- Google reachability check %d/3 ---", i);
		status_led_set(STATUS_LED_NET_CHECK);
		if (ping_google() == 0) {
			LOG_INF("--- check %d/3 PASSED ---", i);
		} else {
			LOG_ERR("--- check %d/3 FAILED ---", i);
			failures++;
		}
		status_led_set(STATUS_LED_LTE_CONNECTED);
		k_sleep(K_SECONDS(3));
	}

	LOG_INF("Reachability checks done. Idling.");
	status_led_set(failures ? STATUS_LED_ERROR : STATUS_LED_IDLE_OK);
	return 0;
}
```

## src/status_led.c
```c
/*
 * Status indication on the board LED(s).
 *
 * Two boards, two capabilities, one API:
 *
 *   Icarus v2  led0/led1/led2 = red/green/blue (gpio0 10/11/12), so state is
 *              carried by colour *and* cadence.
 *   Feather    led0 only (blue D7), so state is carried by cadence alone -- any
 *              non-black colour just lights the single LED.
 *
 * Rendering runs on its own lowest-priority thread. That keeps k_sleep() out of
 * main() and out of the LTE event callback, which must not block: lte_handler()
 * is called from the modem library's own thread.
 *
 * Note on the Feather: its D7 is wired active HIGH while its board DTS declares
 * GPIO_ACTIVE_LOW, so its indication runs inverted -- "on" is dark. That is a
 * board-level quirk, deliberately not compensated for here, because the DTS is
 * what every other app on that board also believes.
 *
 * SPDX-License-Identifier: GPL-3.0-only
 */

#include "status_led.h"

#include <zephyr/kernel.h>
#include <zephyr/devicetree.h>
#include <zephyr/drivers/gpio.h>
#include <zephyr/sys/atomic.h>

#define HAS_LED0 DT_NODE_EXISTS(DT_ALIAS(led0))
#define HAS_RGB	 (DT_NODE_EXISTS(DT_ALIAS(led1)) && DT_NODE_EXISTS(DT_ALIAS(led2)))

#if HAS_LED0

#define COLOR_R BIT(0)
#define COLOR_G BIT(1)
#define COLOR_B BIT(2)

#define COLOR_OFF    0
#define COLOR_RED    COLOR_R
#define COLOR_GREEN  COLOR_G
#define COLOR_BLUE   COLOR_B
#define COLOR_YELLOW (COLOR_R | COLOR_G)
#define COLOR_CYAN   (COLOR_G | COLOR_B)

struct led_pattern {
	uint8_t color;
	uint16_t on_ms;	 /* time lit */
	uint16_t off_ms; /* 0 = solid, never darkened */
};

/* Indexed by enum status_led_state. */
static const struct led_pattern patterns[] = {
	[STATUS_LED_BOOT] = {COLOR_BLUE, 1000, 0},
	[STATUS_LED_AWAIT_PROFILE] = {COLOR_BLUE, 150, 150},
	[STATUS_LED_MODEM_INIT] = {COLOR_YELLOW, 1000, 0},
	[STATUS_LED_LTE_SEARCHING] = {COLOR_YELLOW, 300, 300},
	[STATUS_LED_LTE_CONNECTED] = {COLOR_GREEN, 1000, 0},
	[STATUS_LED_NET_CHECK] = {COLOR_CYAN, 100, 100},
	[STATUS_LED_IDLE_OK] = {COLOR_GREEN, 80, 2400},
	[STATUS_LED_ERROR] = {COLOR_RED, 120, 120},
};

static const struct gpio_dt_spec led_r = GPIO_DT_SPEC_GET(DT_ALIAS(led0), gpios);
#if HAS_RGB
static const struct gpio_dt_spec led_g = GPIO_DT_SPEC_GET(DT_ALIAS(led1), gpios);
static const struct gpio_dt_spec led_b = GPIO_DT_SPEC_GET(DT_ALIAS(led2), gpios);
#endif

static atomic_t requested_state = ATOMIC_INIT(STATUS_LED_BOOT);

static void render(uint8_t color)
{
#if HAS_RGB
	(void)gpio_pin_set_dt(&led_r, (color & COLOR_R) ? 1 : 0);
	(void)gpio_pin_set_dt(&led_g, (color & COLOR_G) ? 1 : 0);
	(void)gpio_pin_set_dt(&led_b, (color & COLOR_B) ? 1 : 0);
#else
	/* Single LED: colour collapses to on/off, cadence carries the meaning. */
	(void)gpio_pin_set_dt(&led_r, color ? 1 : 0);
#endif
}

static void status_led_thread(void *a, void *b, void *c)
{
	ARG_UNUSED(a);
	ARG_UNUSED(b);
	ARG_UNUSED(c);

	if (!gpio_is_ready_dt(&led_r)) {
		return;
	}
	(void)gpio_pin_configure_dt(&led_r, GPIO_OUTPUT_INACTIVE);
#if HAS_RGB
	(void)gpio_pin_configure_dt(&led_g, GPIO_OUTPUT_INACTIVE);
	(void)gpio_pin_configure_dt(&led_b, GPIO_OUTPUT_INACTIVE);
#endif

	while (1) {
		const struct led_pattern *p = &patterns[atomic_get(&requested_state)];

		render(p->color);
		k_sleep(K_MSEC(p->on_ms));

		/* Re-read rather than sleeping out the dark half blindly, so a state
		 * change during a long gap (IDLE_OK rests for 2.4 s) shows up promptly.
		 */
		if (p->off_ms) {
			render(COLOR_OFF);
			k_sleep(K_MSEC(p->off_ms));
		}
	}
}

K_THREAD_DEFINE(status_led_tid, 768, status_led_thread, NULL, NULL, NULL,
		K_LOWEST_APPLICATION_THREAD_PRIO, 0, 0);

void status_led_set(enum status_led_state state)
{
	atomic_set(&requested_state, (atomic_val_t)state);
}

#else /* !HAS_LED0 -- board with no LED at all */

void status_led_set(enum status_led_state state)
{
	ARG_UNUSED(state);
}

#endif /* HAS_LED0 */
```

## src/status_led.h
```c
/*
 * Status indication on the board LED(s).
 *
 * SPDX-License-Identifier: GPL-3.0-only
 */

#ifndef STATUS_LED_H_
#define STATUS_LED_H_

/* Ordered roughly by the sequence a healthy boot passes through, so a glance at
 * the colour tells you how far the device got.
 */
enum status_led_state {
	STATUS_LED_BOOT = 0,	   /* blue, solid      -- powered, app running */
	STATUS_LED_AWAIT_PROFILE,  /* blue, fast blink -- waiting for you to paste a profile */
	STATUS_LED_MODEM_INIT,	   /* yellow, solid    -- bringing the modem up */
	STATUS_LED_LTE_SEARCHING,  /* yellow, blink    -- searching for a network */
	STATUS_LED_LTE_CONNECTED,  /* green, solid     -- registered */
	STATUS_LED_NET_CHECK,	   /* cyan, fast blink -- data transfer in progress */
	STATUS_LED_IDLE_OK,	   /* green, heartbeat -- done, all checks passed */
	STATUS_LED_ERROR,	   /* red, fast blink  -- something failed */
};

/* Safe to call from any context, including the LTE event callback: it only
 * stores the new state, and the rendering thread picks it up.
 */
void status_led_set(enum status_led_state state);

#endif /* STATUS_LED_H_ */
```
