## CMakeLists.txt
```
#
# GNSS sample with nRF Cloud A-GNSS over CoAP, ported to the Feather over SoftSIM.
# src/ and Kconfig are copied from nrf/samples/cellular/gnss so they can be re-synced;
# every board-specific change lives in prj.conf, sysbuild.conf and pm_static.yml.
#
# SPDX-License-Identifier: LicenseRef-Nordic-5-Clause
#

cmake_minimum_required(VERSION 3.20.0)

# Same wiring as the other SoftSIM apps here: upstream onomondo hardcodes
# $ENV{ZEPHYR_BASE}/../modules/lib/onomondo-softsim, which assumes west pulled the module
# into the NCS workspace. We keep it out-of-tree under this project instead.
set(SOFTSIM_MODULE_DIR "${CMAKE_CURRENT_SOURCE_DIR}/../../modules/onomondo-softsim" CACHE PATH "onomondo-softsim module root")
if(NOT EXISTS "${SOFTSIM_MODULE_DIR}/overlay-softsim.conf")
  message(FATAL_ERROR "onomondo-softsim not found at ${SOFTSIM_MODULE_DIR}. Clone it with:\n"
                      "  git clone https://github.com/onomondo/nrf-softsim.git modules/onomondo-softsim\n"
                      "  git -C modules/onomondo-softsim submodule update --init")
endif()
list(APPEND OVERLAY_CONFIG "${SOFTSIM_MODULE_DIR}/overlay-softsim.conf")

# Must come last: the module overlay pins CONFIG_PM_PARTITION_SIZE_TFM=0x18000 and this
# gives back the 0x200 that MCUboot's pad takes. See overlay-mcuboot.conf.
list(APPEND OVERLAY_CONFIG "${CMAKE_CURRENT_SOURCE_DIR}/overlay-mcuboot.conf")

find_package(Zephyr REQUIRED HINTS $ENV{ZEPHYR_BASE})
project(gnss_agnss)

zephyr_library_sources(src/main.c)

# Upstream also builds src/assistance_supl.c under CONFIG_GNSS_SAMPLE_ASSISTANCE_SUPL.
# That file is not copied: the SUPL client library is a separate licensed download that is
# not in nrf/ext/lib/bin/supl here, so selecting it could not link anyway. nRF Cloud A-GNSS
# over CoAP replaces it.
zephyr_library_sources_ifdef(CONFIG_GNSS_SAMPLE_ASSISTANCE_NRF_CLOUD src/assistance.c)
zephyr_library_sources_ifdef(CONFIG_GNSS_SAMPLE_ASSISTANCE_MINIMAL src/assistance_minimal.c)
zephyr_library_sources_ifdef(CONFIG_GNSS_SAMPLE_ASSISTANCE_MINIMAL src/mcc_location_table.c)
```

## Kconfig
```
#
# Copyright (c) 2020 Nordic Semiconductor ASA
#
# SPDX-License-Identifier: LicenseRef-Nordic-5-Clause
#

menu "GNSS sample"

choice
	default GNSS_SAMPLE_MODE_CONTINUOUS
	prompt "Select GNSS operation mode"

config GNSS_SAMPLE_MODE_CONTINUOUS
	bool "Continuous tracking"

config GNSS_SAMPLE_MODE_PERIODIC
	bool "Periodic fixes"

config GNSS_SAMPLE_MODE_TTFF_TEST
	bool "Time-to-first-fix (TTFF) test mode"
	select GNSS_SAMPLE_NMEA_ONLY

endchoice

if GNSS_SAMPLE_MODE_PERIODIC

config GNSS_SAMPLE_PERIODIC_INTERVAL
	int "Fix interval for periodic fixes"
	range 10 65535
	default 120
	help
	  Fix interval (in seconds) for periodic fixes.

config GNSS_SAMPLE_PERIODIC_TIMEOUT
	int "Fix timeout for periodic fixes"
	range 0 65535
	default 120
	help
	  Fix timeout (in seconds) for periodic fixes.
	  If set to zero, GNSS is allowed to run indefinitely until a valid PVT estimate is produced.

endif # GNSS_SAMPLE_MODE_PERIODIC

if GNSS_SAMPLE_MODE_TTFF_TEST

config GNSS_SAMPLE_MODE_TTFF_TEST_COLD_START
	bool "Delete GNSS data before each start (cold start)"
	help
	  When enabled, deletes all stored data from GNSS to force a cold start every time GNSS is started.

config GNSS_SAMPLE_MODE_TTFF_TEST_INTERVAL
	int "Time to wait between TTFF tests in seconds"
	range 1 604800
	default 120

endif # GNSS_SAMPLE_MODE_TTFF_TEST

config GNSS_SAMPLE_LOCATION_UPLINK
	bool "Send each fix to nRF Cloud"
	depends on GNSS_SAMPLE_ASSISTANCE_NRF_CLOUD
	depends on !GNSS_SAMPLE_MODE_TTFF_TEST
	help
	  After a valid fix, send the position to nRF Cloud with
	  nrf_cloud_coap_location_send() so the device appears on the Locations
	  map. Assistance is a download only; without this, nothing about the fix
	  ever leaves the device.

	  Deliberately unavailable in TTFF test mode: that mode cold-starts and
	  re-fetches the full assistance set every run, and an uplink on top only
	  inflates the data cost of a measurement run.

config GNSS_SAMPLE_LOCATION_UPLINK_INTERVAL
	int "Minimum seconds between location uplinks"
	depends on GNSS_SAMPLE_LOCATION_UPLINK
	range 10 86400
	default 60
	help
	  Rate limit. Continuous mode produces a PVT every second; without this
	  the sample would send one CoAP message per second. Each uplink is a few
	  hundred bytes, so this is the knob that sets the data cost.

config GNSS_SAMPLE_NMEA_ONLY
	bool "Output only NMEA strings"
	help
	  Outputs only NMEA strings from the GNSS.

endmenu

choice
	default GNSS_SAMPLE_ASSISTANCE_NONE
	prompt "Select whether GNSS assistance is used or not"

config GNSS_SAMPLE_ASSISTANCE_NONE
	bool "Assistance not used"

config GNSS_SAMPLE_ASSISTANCE_NRF_CLOUD
	bool "Use nRF Cloud A-GNSS"
	select NRF_CLOUD_COAP
	imply NRF_CLOUD_AGNSS
	select MODEM_JWT
	select MODEM_INFO
	select DATE_TIME

config GNSS_SAMPLE_ASSISTANCE_SUPL
	bool "Use SUPL assistance"
	select SUPL_CLIENT_LIB

config GNSS_SAMPLE_ASSISTANCE_MINIMAL
	bool "Use factory almanac, LTE network time and MCC based location"
	select GNSS_SAMPLE_LTE_ON_DEMAND
	select SETTINGS
	select FCB
	select FLASH
	select FLASH_MAP

endchoice

if !GNSS_SAMPLE_ASSISTANCE_NONE

config GNSS_SAMPLE_LTE_ON_DEMAND
	bool "LTE is activated only when needed to fetch A-GNSS data"
	depends on !NRF_CLOUD_PGPS
	help
	  Activates LTE only when it is needed to fetch A-GNSS data. This is not supported when
	  P-GPS is enabled.

endif # !GNSS_SAMPLE_ASSISTANCE_NONE

if GNSS_SAMPLE_ASSISTANCE_SUPL

config GNSS_SAMPLE_SUPL_HOSTNAME
	string "SUPL server hostname"
	help
	  SUPL server hostname.

config GNSS_SAMPLE_SUPL_PORT
	int "SUPL server port number"
	range 0 65535
	default 7275 if GNSS_SAMPLE_SUPL_SEC_TAG > 0
	default 7276
	help
	  SUPL server port number. The OMA UserPlane Location Protocol (ULP) port number is 7275,
	  but some servers are known to use port 7276 for non-TLS connections.

config GNSS_SAMPLE_SUPL_SEC_TAG
	int "Security tag for connection to the SUPL server"
	range 0 2147483667
	default 0
	help
	  Set a non-zero value to use TLS for connection to the SUPL server. When TLS is enabled,
	  a root CA certificate must be stored on the modem.

endif # GNSS_SAMPLE_ASSISTANCE_SUPL

if GNSS_SAMPLE_MODE_CONTINUOUS

choice
	default GNSS_SAMPLE_POWER_SAVING_DISABLED
	prompt "Select GNSS power saving mode (duty-cycling)"

config GNSS_SAMPLE_POWER_SAVING_DISABLED
	bool "No power saving"

config GNSS_SAMPLE_POWER_SAVING_MODERATE
	bool "Power saving without significant performance degradation"

config GNSS_SAMPLE_POWER_SAVING_HIGH
	bool "Power saving with acceptable performance degradation"

endchoice

endif # GNSS_SAMPLE_MODE_CONTINUOUS

config GNSS_SAMPLE_REFERENCE_LATITUDE
	string "Reference position latitude in decimal degrees"
	help
	  When set, the sample calculates the distance from the reference position for each fix.
	  Given in decimal degrees (DD), for example "61.500000".

config GNSS_SAMPLE_REFERENCE_LONGITUDE
	string "Reference position longitude in decimal degrees"
	help
	  When set, the sample calculates the distance from the reference position for each fix.
	  Given in decimal degrees (DD), for example "23.800000".

config GNSS_SAMPLE_LOW_ACCURACY
	bool "Allow low accuracy fixes"
	help
	  Allows fixes with lower accuracy.

if GNSS_SAMPLE_ASSISTANCE_MINIMAL && GNSS_SAMPLE_LOW_ACCURACY

config GNSS_SAMPLE_ASSISTANCE_REFERENCE_ALT
	int "Reference altitude for 3-sat first fix in meters"
	range -32767 32767
	default -32767
	help
	  Reference altitude for 3-sat first fix in meters above the reference ellipsoid surface.
	  The default value -32767 implies that reference altitude is not injected.

endif # GNSS_SAMPLE_ASSISTANCE_MINIMAL && GNSS_SAMPLE_LOW_ACCURACY

menu "Zephyr Kernel"
source "Kconfig.zephyr"
endmenu

module = GNSS_SAMPLE
module-str = GNSS sample
source "$(ZEPHYR_BASE)/subsys/logging/Kconfig.template.log_config"
```

## sysbuild.conf
```
# Partition Manager is deprecated and no longer enabled by default from NCS 3.4, and this
# sample's Kconfig.sysbuild additionally sets `config PARTITION_MANAGER default n`. SoftSIM
# needs PM, so opt in here -- an explicit assignment overrides that default, which is why
# the sample's Kconfig.sysbuild is deliberately not copied. Without PM the /ns build signs
# with `--rom-fixed 0x50000` while MCUboot boots slot0 at 0x10000, and the image is rejected
# into fih_panic_loop with no console output at all.
SB_CONFIG_PARTITION_MANAGER=y

# SB_CONFIG_SOFTSIM_BUNDLE_TEMPLATE_HEX stays OFF: with it on, merged.hex carries a *blank*
# SIM template at 0xF0000 and any SWD flash of it wipes the live provisioning.

# The Feather has no onboard debugger, so MCUboot is built in and later updates can go over
# serial DFU. Must be the SB_CONFIG_ form.
SB_CONFIG_BOOTLOADER_MCUBOOT=y
```

## prj.conf
```kconfig
#
# Copyright (c) 2019 Nordic Semiconductor ASA
#
# SPDX-License-Identifier: LicenseRef-Nordic-5-Clause
#


# General
CONFIG_FPU=y
CONFIG_NRF_MODEM_LIB=y
CONFIG_STDOUT_CONSOLE=y
CONFIG_UART_INTERRUPT_DRIVEN=y
CONFIG_PICOLIBC_IO_FLOAT=y
CONFIG_LOG=y
CONFIG_LOG_MODE_IMMEDIATE=y

# GNSS sample
# nRF Cloud
CONFIG_NRF_CLOUD=y
CONFIG_NRF_CLOUD_COAP=y

# CoAP Client
CONFIG_COAP_CLIENT_BLOCK_SIZE=1024
CONFIG_COAP_CLIENT_STACK_SIZE=6144
CONFIG_COAP_CLIENT_THREAD_PRIORITY=0

# LTE Link Control
CONFIG_LTE_LINK_CONTROL=y
CONFIG_LTE_LC_PSM_MODULE=y
CONFIG_LTE_PSM_REQ=y
# PSM requested periodic TAU 8 hours
CONFIG_LTE_PSM_REQ_RPTAU="00101000"
# PSM requested active time 6 seconds
CONFIG_LTE_PSM_REQ_RAT="00000011"

# AT Host library - Used to send AT commands directy from an UART terminal and to allow
#		    integration with nRF Connect for Desktop LTE Link monitor application.
CONFIG_AT_HOST_LIBRARY=y

# Networking
CONFIG_NETWORKING=y
CONFIG_NET_SOCKETS_OFFLOAD=y
CONFIG_NET_SOCKETS=y
# Disable native network stack to save some memory
CONFIG_NET_NATIVE=n

# Memory and stack configuration
CONFIG_HEAP_MEM_POOL_SIZE=2048
CONFIG_MAIN_STACK_SIZE=4096
CONFIG_SYSTEM_WORKQUEUE_STACK_SIZE=1536

# ---------------------------------------------------------------------------
# Feather / SoftSIM deltas. Everything above is the upstream sample's prj.conf,
# minus CONFIG_TFM_PROFILE_TYPE_MINIMAL and the A-GNSS=n default.
# ---------------------------------------------------------------------------

# TF-M profile
#
# Upstream sets CONFIG_TFM_PROFILE_TYPE_MINIMAL=y. That profile omits AES-CBC, so
# SoftSIM's psa_cipher_encrypt_setup(PSA_ALG_CBC_NO_PADDING) returns -134 and the SIM
# never authenticates. The module's overlay-softsim.conf selects
# CONFIG_TFM_PROFILE_TYPE_NOT_SET=y from the same choice; the line is removed rather
# than overridden because flipping a choice from a later fragment is fragile.

# TF-M Protected Storage must be off. With PS on, Partition Manager places a tfm_ps
# partition at 0xf0000 -- exactly where the SoftSIM filesystem lives -- pushing
# nvs_storage down to 0xe8000, so the app mounts an empty NVS and reports
# "Failed to init FS". Same setting as the other SoftSIM apps here.
CONFIG_TFM_PARTITION_PROTECTED_STORAGE=n

# A-GNSS from nRF Cloud over CoAP. This is the whole point of the app: it replaces the
# SUPL client library, which is a separate licensed download that is not installed here.
# Selects NRF_CLOUD_COAP, which works on this nRF9160 because the device is onboarded by
# preconnect onboarding (see README) and the modem is mfw 1.3.7 (>= 1.3.5 required).
CONFIG_GNSS_SAMPLE_ASSISTANCE_NRF_CLOUD=y

# The GNSS LNA is gated by the modem's COEX0 pin on this board. Without this the GPS
# antenna is electrically disconnected and no fix is ever possible -- no error, no log
# line, the receiver simply never sees a satellite. Neither NCS nor the Asset Tracker
# Template knows about it; the string comes from Circuit Dojo's own gps sample.
# The \% escape resolves to % in the generated .config -- worth checking, because a
# mangled AT string fails silently. 1565-1586 MHz is the GPS band.
CONFIG_MODEM_ANTENNA=y
CONFIG_MODEM_ANTENNA_AT_COEX0="AT\%XCOEX0=1,1,1565,1586"

# System mode must include GPS. CONFIG_LTE_NETWORK_MODE_LTE_M excludes GNSS entirely and
# is a second, independent cause of "no fix" that looks identical to a dead antenna.
# src/main.c:72 BUILD_ASSERTs on this, so a wrong mode fails at compile time.
CONFIG_LTE_NETWORK_MODE_LTE_M_GPS=y

# nRF Cloud credentials and identity. Sec tag 16842753 already holds the CoAP root CA,
# device certificate and private key; the device is onboarded as nrf-<IMEI>. This ID must
# match the certificate CN exactly or nrf_cloud_coap_connect() fails to authenticate.
CONFIG_MODEM_KEY_MGMT=y
CONFIG_NRF_CLOUD_SEC_TAG=16842753
CONFIG_NRF_CLOUD_CLIENT_ID_SRC_IMEI=y
CONFIG_NRF_CLOUD_CLIENT_ID_PREFIX="nrf-"

# Logging mode
#
# The upstream sample sets CONFIG_LOG_MODE_IMMEDIATE=y. On this board that produces
# ~20 characters of line noise per boot instead of console output -- the app runs fine
# (PC sits in the app region) but nothing legible comes out, which looks exactly like a
# baud mismatch or dead board. It is the only config that differs from the three SoftSIM
# apps here that log correctly, all of which use deferred mode.
CONFIG_LOG_MODE_IMMEDIATE=n
CONFIG_LOG_MODE_DEFERRED=y

# Log level for this sample's own module.
#
# The SoftSIM overlay pins CONFIG_LOG_DEFAULT_LEVEL=1 (errors only) to keep the console
# quiet, and src/main.c registers its module as LOG_MODULE_REGISTER(gnss_sample,
# CONFIG_GNSS_SAMPLE_LOG_LEVEL), which follows that default. Every LOG_INF from main.c
# and assistance.c -- including the whole A-GNSS request/inject sequence this app exists
# to observe -- is then filtered out, leaving a boot banner and nothing else. The PVT
# satellite/position output uses printf and is unaffected, which makes the gap look like
# the assistance code is never running.
CONFIG_GNSS_SAMPLE_LOG_LEVEL_INF=y
```

## overlay-ttff-warm.conf
```kconfig
#
# Warm-start TTFF: what a tracker actually pays when it wakes from PSM.
#
#   west build -b circuitdojo_feather/nrf9160/ns -d build-agnss-warm apps\gnss_agnss `
#     -- "-DEXTRA_ZEPHYR_MODULES=.../modules/onomondo-softsim" `
#        "-DOVERLAY_CONFIG=.../apps/gnss_agnss/overlay-ttff-warm.conf"
#
# Same as overlay-ttff.conf except COLD_START is off. That single symbol is the whole
# experiment: with it on, the modem's ephemerides, almanac, iono data, last good fix and
# GPS time are deleted before every run, so each run re-fetches ~5 KB of A-GNSS and
# measures the assisted-cold path (13-18 s here). With it off, run 1 is assisted-cold and
# every run after reuses what the modem already holds -- no fetch, no cellular round trip.
#
# So run 1 is the control and runs 2+ are the measurement. Expect the gap between them to
# be large; that gap is the reason A-GNSS is only needed occasionally rather than per fix.

CONFIG_GNSS_SAMPLE_MODE_TTFF_TEST=y
CONFIG_GNSS_SAMPLE_MODE_TTFF_TEST_COLD_START=n

# Shorter than the cold overlay's 120 s. Nothing is being re-downloaded between runs, so
# the interval is no longer a data-cost knob -- it just sets how many samples per minute
# outdoors. Broadcast ephemeris stays usable for roughly 2 h, so a 60 s gap is well inside
# the valid window and every run after the first should be warm.
CONFIG_GNSS_SAMPLE_MODE_TTFF_TEST_INTERVAL=60
```

## overlay-ttff.conf
```kconfig
#
# TTFF test mode: cold start, A-GNSS from nRF Cloud, repeat.
#
# Build into its own directory so build-agnss keeps the continuous-tracking image:
#   west build -b circuitdojo_feather/nrf9160/ns -d build-agnss-ttff apps\gnss_agnss `
#     -- "-DEXTRA_ZEPHYR_MODULES=.../modules/onomondo-softsim" `
#        "-DOVERLAY_CONFIG=.../apps/gnss_agnss/overlay-ttff.conf"
#
# The app's CMakeLists appends the module overlay and overlay-mcuboot.conf after this
# one; neither touches the symbols below, so the ordering is safe.

# Delete ephemerides, almanacs, iono data, last good fix and GPS time before every run.
# Without it the modem reuses ephemeris across resets and the measured TTFF flatters
# itself -- the 4 min 41 s unassisted baseline was a genuinely cold start.
CONFIG_GNSS_SAMPLE_MODE_TTFF_TEST=y
CONFIG_GNSS_SAMPLE_MODE_TTFF_TEST_COLD_START=y

# Seconds of idle between runs. Each run re-fetches the full A-GNSS set (~5 KB) over
# CoAP, so this is the knob that sets the data cost on the PAYG SIM: roughly one fetch
# per (fix time + this).
CONFIG_GNSS_SAMPLE_MODE_TTFF_TEST_INTERVAL=120
```

## overlay-uplink.conf
```kconfig
#
# Report fixes to nRF Cloud so the device shows up on the Locations map.
#
# A-GNSS is a download only: assistance comes down, the fix is computed on the device
# and never leaves it. This overlay adds the uplink half.
#
#   west build -b circuitdojo_feather/nrf9160/ns -d build-agnss apps\gnss_agnss `
#     -- "-DEXTRA_ZEPHYR_MODULES=.../modules/onomondo-softsim" `
#        "-DOVERLAY_CONFIG=.../apps/gnss_agnss/overlay-uplink.conf"
#
# The app's CMakeLists appends the module overlay and overlay-mcuboot.conf after this
# one; neither touches the symbols below, so the ordering is safe.
#
# Not compatible with overlay-ttff.conf -- GNSS_SAMPLE_LOCATION_UPLINK depends on
# !GNSS_SAMPLE_MODE_TTFF_TEST, so a TTFF measurement run can never pay the uplink cost.

CONFIG_GNSS_SAMPLE_LOCATION_UPLINK=y

# Continuous mode emits a PVT every second. 60 s between uplinks is roughly 60 messages
# an hour of a few hundred bytes each -- call it 50 KB/h on the PAYG SIM. Raise it for
# a long unattended run.
CONFIG_GNSS_SAMPLE_LOCATION_UPLINK_INTERVAL=60

# The uplink needs a wall-clock timestamp or nRF Cloud drops the position. DATE_TIME is
# already selected by GNSS_SAMPLE_ASSISTANCE_NRF_CLOUD; this just makes the dependency
# explicit at the point of use.
CONFIG_DATE_TIME=y
```

## boards/actinius_icarus_nrf9160_ns.conf
```kconfig
# Icarus v2 GNSS antenna.
#
# Board-specific because the two boards gate the GPS antenna in completely
# different ways, and getting it wrong is silent in both directions -- no error,
# no log line, the receiver simply never sees a satellite.
#
#   Feather  an onboard antenna whose LNA is gated by the modem's COEX0 pin, so
#            prj.conf sets CONFIG_MODEM_ANTENNA_AT_COEX0="AT\%XCOEX0=1,1,1565,1586".
#   Icarus   an *external* active patch antenna on the u.FL connector, supplied
#            through MAGPIO0. It needs AT%XMAGPIO instead, and no COEX0 gating.
#
# This file is merged after prj.conf, so these three override the Feather values.
# The %XMAGPIO string is the one Actinius document for the Icarus, and is also
# what NCS ships as the nRF9160 DK default -- same arrangement, same numbers.
# 1574-1577 MHz is the GPS L1 band the supply is switched on for.
#
# The \% escape resolves to % in the generated .config. Worth checking there
# after a build, because a mangled AT string fails silently.
CONFIG_MODEM_ANTENNA=y
CONFIG_MODEM_ANTENNA_GNSS_EXTERNAL=y
CONFIG_MODEM_ANTENNA_AT_MAGPIO="AT\%XMAGPIO=1,0,0,1,1,1574,1577"

# Bare form = COEX0 gating disabled. prj.conf assigns the Feather's gating string
# explicitly, so leaving this unset would carry it over to a board that has no
# such pin.
CONFIG_MODEM_ANTENNA_AT_COEX0="AT\%XCOEX0"
```

## src/assistance.c
```c
/*
 * Copyright (c) 2021 Nordic Semiconductor ASA
 *
 * SPDX-License-Identifier: LicenseRef-Nordic-5-Clause
 */

#include <stdlib.h>
#include <zephyr/kernel.h>
#include <zephyr/logging/log.h>
#include <modem/modem_info.h>
#if defined(CONFIG_NRF_CLOUD_AGNSS)
#include <net/nrf_cloud_agnss.h>
#endif /* CONFIG_NRF_CLOUD_AGNSS */
#if defined(CONFIG_NRF_CLOUD_PGPS)
#include <net/nrf_cloud_pgps.h>
#endif /* CONFIG_NRF_CLOUD_PGPS */
#include <net/nrf_cloud_coap.h>
#if defined(CONFIG_GNSS_SAMPLE_LOCATION_UPLINK)
#include <net/nrf_cloud.h>
#endif /* CONFIG_GNSS_SAMPLE_LOCATION_UPLINK */

#include "assistance.h"

LOG_MODULE_DECLARE(gnss_sample, CONFIG_GNSS_SAMPLE_LOG_LEVEL);

#if defined(CONFIG_NRF_CLOUD_AGNSS)
static char agnss_data_buf[NRF_CLOUD_AGNSS_MAX_DATA_SIZE];
#endif /* CONFIG_NRF_CLOUD_AGNSS */

#if defined(CONFIG_NRF_CLOUD_PGPS)
static struct nrf_modem_gnss_agnss_data_frame agnss_need;
static struct gps_pgps_request pgps_request;
static struct nrf_cloud_pgps_prediction *prediction;
static struct k_work get_pgps_data_work;
static struct k_work inject_pgps_data_work;
#endif /* CONFIG_NRF_CLOUD_PGPS */

static struct k_work_q *work_q;
static volatile bool assistance_active;
static bool coap_connected;

#if defined(CONFIG_NRF_CLOUD_AGNSS)
static int serving_cell_info_get(struct lte_lc_cell *serving_cell)
{
	int err;

	err = modem_info_init();
	if (err) {
		return err;
	}

	char resp_buf[MODEM_INFO_MAX_RESPONSE_SIZE];

	err = modem_info_string_get(MODEM_INFO_CELLID,
				    resp_buf,
				    MODEM_INFO_MAX_RESPONSE_SIZE);
	if (err < 0) {
		return err;
	}

	serving_cell->id = strtol(resp_buf, NULL, 16);

	err = modem_info_string_get(MODEM_INFO_AREA_CODE,
				    resp_buf,
				    MODEM_INFO_MAX_RESPONSE_SIZE);
	if (err < 0) {
		return err;
	}

	serving_cell->tac = strtol(resp_buf, NULL, 16);

	/* Request for MODEM_INFO_MNC returns both MNC and MCC in the same string. */
	err = modem_info_string_get(MODEM_INFO_OPERATOR,
				    resp_buf,
				    MODEM_INFO_MAX_RESPONSE_SIZE);
	if (err < 0) {
		return err;
	}

	serving_cell->mnc = strtol(&resp_buf[3], NULL, 10);
	/* Null-terminate MCC, read and store it. */
	resp_buf[3] = '\0';
	serving_cell->mcc = strtol(resp_buf, NULL, 10);

	return 0;
}
#endif /* CONFIG_NRF_CLOUD_AGNSS */

#if defined(CONFIG_NRF_CLOUD_PGPS)
static void get_pgps_data_work_fn(struct k_work *work)
{
	ARG_UNUSED(work);

	int err;

	assistance_active = true;

	LOG_INF("Sending request for P-GPS predictions to nRF Cloud...");

	struct nrf_cloud_coap_pgps_request request = {
		.pgps_req = &pgps_request
	};

	struct nrf_cloud_pgps_result file_location = {0};

	static char host[64];
	static char path[128];

	memset(host, 0, sizeof(host));
	memset(path, 0, sizeof(path));

	file_location.host = host;
	file_location.host_sz = sizeof(host);
	file_location.path = path;
	file_location.path_sz = sizeof(path);

	err = nrf_cloud_coap_pgps_url_get(&request, &file_location);
	if (err) {
		LOG_ERR("GNSS: Failed to get P-GPS data, error: %d", err);

		nrf_cloud_pgps_request_reset();

		goto exit;
	}

	LOG_INF("Processing P-GPS response");

	err = nrf_cloud_pgps_update(&file_location);
	if (err) {
		LOG_ERR("Failed to process P-GPS response, error: %d", err);

		nrf_cloud_pgps_request_reset();

		goto exit;
	}

	LOG_INF("P-GPS response processed");

	err = nrf_cloud_pgps_notify_prediction();
	if (err) {
		LOG_ERR("Failed to request current prediction, error: %d", err);

		goto exit;
	}

	LOG_INF("P-GPS predictions requested");
exit:
	assistance_active = false;
}

static void inject_pgps_data_work_fn(struct k_work *work)
{
	ARG_UNUSED(work);

	int err;

	assistance_active = true;

	LOG_INF("Injecting P-GPS ephemerides");

	err = nrf_cloud_pgps_inject(prediction, &agnss_need);
	if (err) {
		LOG_ERR("Failed to inject P-GPS ephemerides");
	}

	err = nrf_cloud_pgps_preemptive_updates();
	if (err) {
		LOG_ERR("Failed to request P-GPS updates");
	}

	assistance_active = false;
}

static void pgps_event_handler(struct nrf_cloud_pgps_event *event)
{
	switch (event->type) {
	case PGPS_EVT_AVAILABLE:
		prediction = event->prediction;

		k_work_submit_to_queue(work_q, &inject_pgps_data_work);
		break;

	case PGPS_EVT_REQUEST:
		memcpy(&pgps_request, event->request, sizeof(pgps_request));

		k_work_submit_to_queue(work_q, &get_pgps_data_work);
		break;

	case PGPS_EVT_LOADING:
		LOG_INF("Loading P-GPS predictions");
		assistance_active = true;
		break;

	case PGPS_EVT_READY:
		LOG_INF("P-GPS predictions ready");
		assistance_active = false;
		break;

	default:
		/* No action needed */
		break;
	}
}
#endif /* CONFIG_NRF_CLOUD_PGPS */

#if defined(CONFIG_NRF_CLOUD_AGNSS)
static const char *get_system_string(uint8_t system_id)
{
	switch (system_id) {
	case NRF_MODEM_GNSS_SYSTEM_INVALID:
		return "invalid";

	case NRF_MODEM_GNSS_SYSTEM_GPS:
		return "GPS";

	case NRF_MODEM_GNSS_SYSTEM_QZSS:
		return "QZSS";

	default:
		return "unknown";
	}
}
#endif /* CONFIG_NRF_CLOUD_AGNSS */

int assistance_init(struct k_work_q *assistance_work_q)
{
	work_q = assistance_work_q;

	int err = nrf_cloud_coap_init();

	if (err) {
		LOG_ERR("Failed to initialize nRF Cloud CoAP client: %d", err);
		return err;
	}

#if defined(CONFIG_NRF_CLOUD_PGPS)
	k_work_init(&get_pgps_data_work, get_pgps_data_work_fn);
	k_work_init(&inject_pgps_data_work, inject_pgps_data_work_fn);

	struct nrf_cloud_pgps_init_param pgps_param = {
		.event_handler = pgps_event_handler,
		/* storage is defined by CONFIG_NRF_CLOUD_PGPS_STORAGE */
		.storage_base = 0u,
		.storage_size = 0u
	};

	if (nrf_cloud_pgps_init(&pgps_param) != 0) {
		LOG_ERR("Failed to initialize P-GPS");
		return -1;
	}
#endif /* CONFIG_NRF_CLOUD_PGPS */

	return 0;
}

int assistance_request(struct nrf_modem_gnss_agnss_data_frame *agnss_request)
{
	int err = 0;

	if (!coap_connected) {
		err = nrf_cloud_coap_connect(NULL);
		if (err) {
			LOG_ERR("Connecting to nRF Cloud failed: %d", err);
			return err;
		}
		coap_connected = true;
	}

#if defined(CONFIG_NRF_CLOUD_PGPS)
	/* Store the A-GNSS data request for P-GPS use. */
	memcpy(&agnss_need, agnss_request, sizeof(agnss_need));

#if defined(CONFIG_NRF_CLOUD_AGNSS)
	if (!agnss_request->data_flags) {
		/* No assistance needed from A-GNSS, skip directly to P-GPS. */
		nrf_cloud_pgps_notify_prediction();
		return 0;
	}

	/* P-GPS will handle GPS ephemerides, so skip those. */
	agnss_request->system[0].sv_mask_ephe = 0;
	/* GPS almanacs are not needed with P-GPS, so skip those. */
	agnss_request->system[0].sv_mask_alm = 0;
#endif /* CONFIG_NRF_CLOUD_AGNSS */
#endif /* CONFIG_NRF_CLOUD_PGPS */
#if defined(CONFIG_NRF_CLOUD_AGNSS)
	assistance_active = true;

	struct nrf_cloud_coap_agnss_request request = {
		NRF_CLOUD_COAP_AGNSS_REQ_CUSTOM,
		agnss_request,
		NULL,
#if defined(CONFIG_NRF_CLOUD_AGNSS_FILTERED_RUNTIME)
		true,
		/* Note: if you change the mask angle here, you may want to
		 * also change it to match in gnss_init_and_start() in main.c.
		 */
		CONFIG_NRF_CLOUD_AGNSS_ELEVATION_MASK
#endif
	};

	struct nrf_cloud_coap_agnss_result result = {
		agnss_data_buf,
		sizeof(agnss_data_buf),
		0
	};

	struct lte_lc_cells_info net_info = { 0 };

	err = serving_cell_info_get(&net_info.current_cell);
	if (err) {
		LOG_ERR("Could not get cell info, error: %d", err);
	} else {
		/* Network info for the location request. */
		request.net_info = &net_info;
	}

	LOG_INF("Requesting A-GNSS data: data_flags: 0x%02x", agnss_request->data_flags);
	for (int i = 0; i < agnss_request->system_count; i++) {
		LOG_INF("Requesting A-GNSS data: %s ephe: 0x%llx, alm: 0x%llx",
			get_system_string(agnss_request->system[i].system_id),
			agnss_request->system[i].sv_mask_ephe,
			agnss_request->system[i].sv_mask_alm);
	}

	err = nrf_cloud_coap_agnss_data_get(&request, &result);
	if (err) {
		LOG_ERR("Failed to get A-GNSS data, error: %d", err);
		goto agnss_exit;
	}

	LOG_INF("Processing A-GNSS data");

	err = nrf_cloud_agnss_process(result.buf, result.agnss_sz);
	if (err) {
		LOG_ERR("Failed to process A-GNSS data, error: %d", err);
		goto agnss_exit;
	}

	LOG_INF("A-GNSS data processed");

agnss_exit:
	assistance_active = false;
#endif /* CONFIG_NRF_CLOUD_AGNSS */

#if defined(CONFIG_NRF_CLOUD_PGPS)
	nrf_cloud_pgps_notify_prediction();
#endif /* CONFIG_NRF_CLOUD_PGPS */

	return err;
}

bool assistance_is_active(void)
{
	return assistance_active;
}

#if defined(CONFIG_GNSS_SAMPLE_LOCATION_UPLINK)
int assistance_location_send(const struct nrf_modem_gnss_pvt_data_frame *pvt, int64_t ts_ms)
{
	int err;

	/* nrf_cloud_coap_location_send() only accepts NRF_CLOUD_GNSS_TYPE_PVT, so the
	 * modem frame is copied field by field rather than passed as MODEM_PVT.
	 */
	struct nrf_cloud_gnss_data gnss = {
		.type = NRF_CLOUD_GNSS_TYPE_PVT,
		.ts_ms = ts_ms,
		.pvt = {
			.lat = pvt->latitude,
			.lon = pvt->longitude,
			.accuracy = pvt->accuracy,
			.alt = pvt->altitude,
			.speed = pvt->speed,
			.heading = pvt->heading,
			.has_alt = 1,
			.has_speed = 1,
			.has_heading = 1,
		},
	};

	if (!coap_connected) {
		err = nrf_cloud_coap_connect(NULL);
		if (err) {
			LOG_ERR("Connecting to nRF Cloud failed: %d", err);
			return err;
		}
		coap_connected = true;
	}

	/* Non-confirmable: a dropped position costs nothing, the next fix supersedes it. */
	err = nrf_cloud_coap_location_send(&gnss, false);
	if (err == -EACCES) {
		/* Connection went away underneath us, most likely a PSM sleep long enough
		 * for the DTLS session to lapse. Reconnect once and retry.
		 */
		coap_connected = false;
		err = nrf_cloud_coap_connect(NULL);
		if (err) {
			LOG_ERR("Reconnecting to nRF Cloud failed: %d", err);
			return err;
		}
		coap_connected = true;
		err = nrf_cloud_coap_location_send(&gnss, false);
	}

	if (err) {
		LOG_ERR("Failed to send location, error: %d", err);
		return err;
	}

	LOG_INF("Location sent to nRF Cloud: %.06f, %.06f (%.01f m)",
		pvt->latitude, pvt->longitude, (double)pvt->accuracy);

	return 0;
}
#endif /* CONFIG_GNSS_SAMPLE_LOCATION_UPLINK */
```

## src/assistance.h
```c
/*
 * Copyright (c) 2019 Nordic Semiconductor ASA
 *
 * SPDX-License-Identifier: LicenseRef-Nordic-5-Clause
 */

#ifndef ASSISTANCE_H_
#define ASSISTANCE_H_

#ifdef __cplusplus
extern "C" {
#endif

/**
 * @brief Initializes the assistance module.
 *
 * @param[in] assistance_work_q Work queue that can be used by the assistance module.
 *
 * @retval 0 on success.
 * @retval -1 in case of an error.
 */
int assistance_init(struct k_work_q *assistance_work_q);

/**
 * @brief Handles an assistance data request.
 *
 * @details Fetches and injects assistance data to the GNSS.
 *
 * @param[in] agnss_request A-GNSS data requested by GNSS.
 *
 * @retval 0 on success.
 * @retval <0 in case of an error.
 */
int assistance_request(struct nrf_modem_gnss_agnss_data_frame *agnss_request);

/**
 * @brief Returns assistance module state.
 *
 * @retval true if assistance module is downloading data.
 * @retval false if assistance module is idle.
 */
bool assistance_is_active(void);

/**
 * @brief Sends a fix to nRF Cloud so it appears on the Locations map.
 *
 * @details Reuses the CoAP connection the assistance module already holds.
 *          Must be called from the assistance work queue, so that it cannot
 *          overlap an in-flight assistance_request() on the same connection.
 *
 * @param[in] pvt   Fix to report.
 * @param[in] ts_ms UNIX epoch timestamp in ms, or 0 if unknown.
 *
 * @retval 0 on success.
 * @retval <0 in case of an error.
 */
int assistance_location_send(const struct nrf_modem_gnss_pvt_data_frame *pvt, int64_t ts_ms);

#ifdef __cplusplus
}
#endif

#endif /* ASSISTANCE_H_ */
```
