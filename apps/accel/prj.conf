## sysbuild.conf
```
# Partition Manager is deprecated and no longer enabled by default from NCS 3.4, but it is
# required here so pm_static.yml can pin TF-M storage clear of the SoftSIM. See prj.conf.
SB_CONFIG_PARTITION_MANAGER=y

# NCS 3.x selects MCUboot through sysbuild; the NCS 2.x CONFIG_BOOTLOADER_MCUBOOT form is
# silently ignored and yields an unsigned image the bootloader rejects.
SB_CONFIG_BOOTLOADER_MCUBOOT=y
```

## prj.conf
```kconfig
# LIS2DH accelerometer on i2c1. The board DTS already declares the node
# (lis2dh: lis2dh@18, compatible "st,lis2dh" in
# zephyr/boards/circuitdojo/feather/circuitdojo_feather_nrf9160_common.dtsi:139), so no
# overlay is needed -- only the driver.
CONFIG_I2C=y
CONFIG_SENSOR=y
CONFIG_LIS2DH=y

# Console on uart0, the Feather's CP2102N USB-UART (COM15 @ 115200).
CONFIG_SERIAL=y
CONFIG_CONSOLE=y
CONFIG_UART_CONSOLE=y
CONFIG_PRINTK=y

# printf("%f") for the tilt angles.
CONFIG_FPU=y
CONFIG_PICOLIBC_IO_FLOAT=y

# TF-M Protected Storage off, and see pm_static.yml.
#
# This app has no modem and no SoftSIM, but it must still not land on the SoftSIM's flash.
# Without a static layout Partition Manager puts TF-M storage at tfm_otp_nv_counters
# 0xf0000 and tfm_ps 0xf8000 -- exactly over the SoftSIM's nvs_storage and tfm_its -- and
# merely booting the app then destroys the provisioned SIM, with no flash write from the
# host to blame. That is what apps/blinky was doing until it was fixed.
CONFIG_TFM_PARTITION_PROTECTED_STORAGE=n

# Logging, so a fault prints its reason and not just a bare register dump. Without
# CONFIG_LOG the `<err> os: ***** ... FAULT *****` line never appears and all you get is
# the printk register dump, which does not say what kind of fault it was.
CONFIG_LOG=y
CONFIG_LOG_MODE_DEFERRED=y

# Give up TF-M's secure console so the app can reach I2C1.
#
# On the nRF9160, SPIM1/SPIS1/TWIM1/TWIS1/UARTE1 all share one peripheral ID -- Nordic
# calls it a "Serial-Box" -- and the SPU can only assign security per ID, not per
# peripheral. TF-M defaults to CONFIG_TFM_SECURE_UART1=y for its own boot logging, and
# therefore deliberately leaves Serial-Box 1 secure:
#
#   nrf/../tf-m/platform/ext/target/nordic_nrf/common/core/target_cfg_53_91.c:357
#     #if !(defined(SECURE_UART1) && NRF_SECURE_UART_INSTANCE == 1)
#             /* UART1 is a secure peripheral, so we need to leave Serial-Box 1 as Secure */
#             NRF_SPIM1_S_BASE,
#     #endif
#
# The Feather's accelerometer is on i2c1 = TWIM1 = that same box, so any non-secure access
# takes a bus fault at 0x40009000 -- "Precise data bus error", with no hint that a UART is
# to blame. Turning TF-M's secure UART off puts Serial-Box 1 back in the non-secure list.
# We lose TF-M's own boot messages, which this app does not need; the app console is uart0
# and is unaffected.
CONFIG_TFM_SECURE_UART=n
# TF-M still links uart_stdout.c for its own logging, which then fails with
# "undefined reference to Driver_USART1" once the secure UART driver is gone, so its
# logging has to be silenced as well.
CONFIG_TFM_LOG_LEVEL_SILENCE=y
```

## src/main.c
```c
/*
 * LIS2DH accelerometer readout for the Circuit Dojo nRF9160 Feather.
 *
 * Reports raw acceleration plus the board's resting orientation, derived from which way
 * gravity points. No modem, so this costs no cellular data.
 *
 * The sensor sits on i2c1 at 0x18 and is already described by the board DTS as
 * `lis2dh: lis2dh@18` -- see
 * zephyr/boards/circuitdojo/feather/circuitdojo_feather_nrf9160_common.dtsi:139.
 *
 * SPDX-License-Identifier: Apache-2.0
 */

#include <math.h>
#include <stdio.h>
#include <zephyr/kernel.h>
#include <zephyr/device.h>
#include <zephyr/drivers/sensor.h>

#define SAMPLE_PERIOD_MS 500

/* picolibc only exposes M_PI under _DEFAULT_SOURCE, which Zephyr does not set here. */
#define RAD_TO_DEG (180.0 / 3.14159265358979323846)

/* Gravity is ~9.81 m/s^2. A face counts as "down" only when it carries most of that, so a
 * board held at an angle reports "tilted" rather than flickering between two faces.
 */
#define FACE_THRESHOLD 7.0

static const struct device *const accel = DEVICE_DT_GET_ANY(st_lis2dh);

static const char *orientation(double x, double y, double z)
{
	if (z >= FACE_THRESHOLD) {
		return "flat, component side up";
	}
	if (z <= -FACE_THRESHOLD) {
		return "flat, component side down";
	}
	if (x >= FACE_THRESHOLD) {
		return "on its side (+X down)";
	}
	if (x <= -FACE_THRESHOLD) {
		return "on its side (-X down)";
	}
	if (y >= FACE_THRESHOLD) {
		return "upright (+Y down)";
	}
	if (y <= -FACE_THRESHOLD) {
		return "upright (-Y down)";
	}

	return "tilted";
}

int main(void)
{
	struct sensor_value val[3];
	int err;

	printk("nRF9160 Feather accelerometer (LIS2DH)\n");

	if (accel == NULL) {
		printk("error: no st,lis2dh node found in the devicetree\n");
		return 0;
	}

	if (!device_is_ready(accel)) {
		printk("error: %s is not ready -- check the i2c1 bus and that the sensor is "
		       "powered\n",
		       accel->name);
		return 0;
	}

	printk("Reading %s every %d ms\n\n", accel->name, SAMPLE_PERIOD_MS);

	while (1) {
		err = sensor_sample_fetch(accel);
		if (err) {
			printk("error: sensor_sample_fetch failed (%d)\n", err);
			k_msleep(SAMPLE_PERIOD_MS);
			continue;
		}

		err = sensor_channel_get(accel, SENSOR_CHAN_ACCEL_XYZ, val);
		if (err) {
			printk("error: sensor_channel_get failed (%d)\n", err);
			k_msleep(SAMPLE_PERIOD_MS);
			continue;
		}

		double x = sensor_value_to_double(&val[0]);
		double y = sensor_value_to_double(&val[1]);
		double z = sensor_value_to_double(&val[2]);

		/* Tilt away from flat. Roll is rotation about X, pitch about Y; both are
		 * undefined in yaw because gravity alone cannot observe heading.
		 */
		double roll = atan2(y, z) * RAD_TO_DEG;
		double pitch = atan2(-x, sqrt(y * y + z * z)) * RAD_TO_DEG;
		double magnitude = sqrt(x * x + y * y + z * z);

		printf("X %7.2f  Y %7.2f  Z %7.2f m/s^2 | |a| %5.2f | roll %7.2f  pitch %7.2f deg | %s\n",
		       x, y, z, magnitude, roll, pitch, orientation(x, y, z));

		k_msleep(SAMPLE_PERIOD_MS);
	}

	return 0;
}
```
