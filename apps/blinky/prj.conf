## sysbuild.conf
```
# Partition Manager is deprecated and no longer enabled by default from NCS 3.4.
# Without it the /ns build signs the image with `--rom-fixed 0x50000` (the
# slot0_ns DTS address) while MCUboot still boots slot0 at 0x10000. MCUboot's
# boot_rom_address_check() sees the mismatch and lands in fih_panic_loop, so the
# app never starts and the console stays silent. Opt in, as the other apps do.
SB_CONFIG_PARTITION_MANAGER=y

# NCS 3.x builds MCUboot through sysbuild, not CONFIG_BOOTLOADER_MCUBOOT in
# prj.conf (that form is NCS 2.x and is what the Circuit Dojo docs still show).
# This is what produces the signed image the Feather's bootloader will accept.
SB_CONFIG_BOOTLOADER_MCUBOOT=y
```

## prj.conf
```kconfig
CONFIG_GPIO=y

# Console on uart0, which is the Feather's CP2102N USB-UART (COM15 @ 115200).
CONFIG_SERIAL=y
CONFIG_CONSOLE=y
CONFIG_UART_CONSOLE=y
CONFIG_PRINTK=y

# TF-M Protected Storage off, and see pm_static.yml.
#
# blinky has no SoftSIM, but it must still not land on the SoftSIM's flash. Without a
# static layout Partition Manager put this app's TF-M storage at:
#
#   tfm_its              0xe8000 - 0xea000
#   tfm_otp_nv_counters  0xf0000 - 0xf2000   <- on top of the SoftSIM filesystem
#   tfm_ps               0xf8000 - 0xfc000   <- on top of the SoftSIM apps' tfm_its
#
# nvs_storage on the SoftSIM apps is 0xf0000-0xf8000 and their tfm_its is 0xf8000, so
# simply *booting* blinky made TF-M write NV counters over the provisioned SIM and its
# PSA keys. Nothing is flashed there -- blinky's image ends at 0x2DB27 -- so it looks
# like the SIM died on its own; the tell is C0DE8112 appearing at 0xf0000.
# Cost two re-provisions on 2026-09-11 before it was tracked down.
CONFIG_TFM_PARTITION_PROTECTED_STORAGE=n
```

## src/main.c
```c
/*
 * Blinky: toolchain smoke test, built for both boards in this repo.
 *
 * Drives whatever the board's "led0" alias points at:
 *   Feather  blue LED D7,  gpio0 pin 3,  GPIO_ACTIVE_LOW
 *            zephyr/boards/circuitdojo/feather/circuitdojo_feather_nrf9160_common.dtsi
 *   Icarus   red LED,      gpio0 pin 10, GPIO_ACTIVE_LOW
 *            zephyr/boards/actinius/icarus/actinius_icarus_common.dtsi
 *
 * Note the Feather's D7 is wired active HIGH against its own board DTS, so its
 * LED runs inverted from what this code says; the Icarus's declaration is honest.
 *
 * SPDX-License-Identifier: Apache-2.0
 */

#include <zephyr/kernel.h>
#include <zephyr/drivers/gpio.h>
#include <zephyr/sys/printk.h>

#define SLEEP_TIME_MS 500

#define LED0_NODE DT_ALIAS(led0)

static const struct gpio_dt_spec led = GPIO_DT_SPEC_GET(LED0_NODE, gpios);

int main(void)
{
	int ret;
	bool led_on = true;

	printk("%s blinky\n", CONFIG_BOARD_TARGET);

	if (!gpio_is_ready_dt(&led)) {
		printk("error: LED device %s is not ready\n", led.port->name);
		return 0;
	}

	ret = gpio_pin_configure_dt(&led, GPIO_OUTPUT_ACTIVE);
	if (ret < 0) {
		printk("error: gpio_pin_configure_dt failed (%d)\n", ret);
		return 0;
	}

	while (1) {
		ret = gpio_pin_toggle_dt(&led);
		if (ret < 0) {
			printk("error: gpio_pin_toggle_dt failed (%d)\n", ret);
			return 0;
		}

		led_on = !led_on;
		printk("LED %s\n", led_on ? "ON" : "OFF");
		k_msleep(SLEEP_TIME_MS);
	}

	return 0;
}
```
